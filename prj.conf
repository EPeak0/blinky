## prj.conf
```kconfig
# C++ support
CONFIG_CPP=y
CONFIG_REQUIRES_FULL_LIBCPP=y
CONFIG_STD_CPP17=y

# use zpp_lib
CONFIG_USE_ZPP_LIB=y

# log
CONFIG_LOG=y
#CONFIG_KERNEL_LOG_LEVEL_DBG=y
#CONFIG_ZPP_RTOS_LOG_LEVEL_DBG=y
#CONFIG_ZPP_DRIVERS_LOG_LEVEL_DBG=y
CONFIG_APP_LOG_LEVEL_DBG=y

# debug
CONFIG_DEBUG=y
CONFIG_DEBUG_OPTIMIZATIONS=y

CONFIG_THREAD_STACK_INFO=y
```

## src/main.cpp
```c
// stl
#include <chrono>

// zpp-lib
#include "zpp_include/thread.hpp"
#include "zpp_include/this_thread.hpp"
#include "zpp_include/digital_out.hpp"
#include <zephyr/logging/log.h>

LOG_MODULE_REGISTER(blinky, CONFIG_APP_LOG_LEVEL);

void blink() {
    zpp_lib::DigitalOut led(zpp_lib::DigitalOut::PinName::LED0);
    using namespace std::literals;
    static std::chrono::milliseconds blinkInterval = 1000ms;

    while (true) {
        led = !led;
        zpp_lib::ThisThread::sleep_for(blinkInterval);
    }
}

int main(void) {
    LOG_DBG("Running on board %s", CONFIG_BOARD_TARGET);
    LOG_DBG("Starting thread");
    zpp_lib::Thread thread;
    auto res = thread.start(blink);
    if (! res) {
        LOG_ERR("Could not start thread (%d)", static_cast<int>(res.error()));
        return -1;
    }

    res = thread.join();
    if (! res) {
        LOG_ERR("Could not terminate thread (%d)", static_cast<int>(res.error()));
        return -1;
    }

    return 0;
}
```
